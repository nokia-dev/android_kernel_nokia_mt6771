/*
 * Copyright (C) 2010 - 2017 Novatek, Inc.
 *
 * $Revision: 19589 $
 * $Date: 2017-11-28 21:26:00 +0800 (?变?, 28 ?佷???2017) $
 *
 * This program is free software; you can redistribute it and/or modify
 * it under the terms of the GNU General Public License as published by
 * the Free Software Foundation; either version 2 of the License, or
 * (at your option) any later version.
 *
 * This program is distributed in the hope that it will be useful, but WITHOUT
 * ANY WARRANTY; without even the implied warranty of MERCHANTABILITY or
 * FITNESS FOR A PARTICULAR PURPOSE.  See the GNU General Public License for
 * more details.
 *
 */

&i2c0 {

	/* Novatek device tree node */
	cap_touch@62 {
		compatible = "mediatek,cap_touch";	//Use MTK default touch
		reg = <0x62>;
		status = "ok";

		/* MP */
		novatek,mp-support-dt;

		novatek-mp-criteria-5105@0 {
			#address-cells = <1>;
			#size-cells = <0>;
			compatible = "novatek-mp-criteria-5105";//5106 is pid of Truly586	;5105 is pid of TM586

			/* MP Config */
			IC_X_CFG_SIZE = <18>;
			IC_Y_CFG_SIZE = <32>;
			IC_KEY_CFG_SIZE = <4>;
			X_Channel = <18>;
			Y_Channel = <32>;
			AIN_X = <0 1 2 3 4 5 6 7 8 9 10 11 12 13 14 15 16 17>;
			AIN_Y = <0 1 2 3 4 5 6 7 8 9 10 11 12 13 14 15 16 17 18 19 20 21 22 23 24 25 26 27 28 29 30 31>;
			AIN_KEY = <0 1 2 0xFF>;

			/* MP Criteria */
			PS_Config_Lmt_Short_Rawdata_P = <
				14008 14008 14008 14008 14008 14008 14008 14008 14008 14008 14008 14008 14008 14008 14008 14008 14008 14008
				14008 14008 14008 14008 14008 14008 14008 14008 14008 14008 14008 14008 14008 14008 14008 14008 14008 14008
				14008 14008 14008 14008 14008 14008 14008 14008 14008 14008 14008 14008 14008 14008 14008 14008 14008 14008
				14008 14008 14008 14008 14008 14008 14008 14008 14008 14008 14008 14008 14008 14008 14008 14008 14008 14008
				14008 14008 14008 14008 14008 14008 14008 14008 14008 14008 14008 14008 14008 14008 14008 14008 14008 14008
				14008 14008 14008 14008 14008 14008 14008 14008 14008 14008 14008 14008 14008 14008 14008 14008 14008 14008
				14008 14008 14008 14008 14008 14008 14008 14008 14008 14008 14008 14008 14008 14008 14008 14008 14008 14008
				14008 14008 14008 14008 14008 14008 14008 14008 14008 14008 14008 14008 14008 14008 14008 14008 14008 14008
				14008 14008 14008 14008 14008 14008 14008 14008 14008 14008 14008 14008 14008 14008 14008 14008 14008 14008
				14008 14008 14008 14008 14008 14008 14008 14008 14008 14008 14008 14008 14008 14008 14008 14008 14008 14008
				14008 14008 14008 14008 14008 14008 14008 14008 14008 14008 14008 14008 14008 14008 14008 14008 14008 14008
				14008 14008 14008 14008 14008 14008 14008 14008 14008 14008 14008 14008 14008 14008 14008 14008 14008 14008
				14008 14008 14008 14008 14008 14008 14008 14008 14008 14008 14008 14008 14008 14008 14008 14008 14008 14008
				14008 14008 14008 14008 14008 14008 14008 14008 14008 14008 14008 14008 14008 14008 14008 14008 14008 14008
				14008 14008 14008 14008 14008 14008 14008 14008 14008 14008 14008 14008 14008 14008 14008 14008 14008 14008
				14008 14008 14008 14008 14008 14008 14008 14008 14008 14008 14008 14008 14008 14008 14008 14008 14008 14008
				14008 14008 14008 14008 14008 14008 14008 14008 14008 14008 14008 14008 14008 14008 14008 14008 14008 14008
				14008 14008 14008 14008 14008 14008 14008 14008 14008 14008 14008 14008 14008 14008 14008 14008 14008 14008
				14008 14008 14008 14008 14008 14008 14008 14008 14008 14008 14008 14008 14008 14008 14008 14008 14008 14008
				14008 14008 14008 14008 14008 14008 14008 14008 14008 14008 14008 14008 14008 14008 14008 14008 14008 14008
				14008 14008 14008 14008 14008 14008 14008 14008 14008 14008 14008 14008 14008 14008 14008 14008 14008 14008
				14008 14008 14008 14008 14008 14008 14008 14008 14008 14008 14008 14008 14008 14008 14008 14008 14008 14008
				14008 14008 14008 14008 14008 14008 14008 14008 14008 14008 14008 14008 14008 14008 14008 14008 14008 14008
				14008 14008 14008 14008 14008 14008 14008 14008 14008 14008 14008 14008 14008 14008 14008 14008 14008 14008
				14008 14008 14008 14008 14008 14008 14008 14008 14008 14008 14008 14008 14008 14008 14008 14008 14008 14008
				14008 14008 14008 14008 14008 14008 14008 14008 14008 14008 14008 14008 14008 14008 14008 14008 14008 14008
				14008 14008 14008 14008 14008 14008 14008 14008 14008 14008 14008 14008 14008 14008 14008 14008 14008 14008
				14008 14008 14008 14008 14008 14008 14008 14008 14008 14008 14008 14008 14008 14008 14008 14008 14008 14008
				14008 14008 14008 14008 14008 14008 14008 14008 14008 14008 14008 14008 14008 14008 14008 14008 14008 14008
				14008 14008 14008 14008 14008 14008 14008 14008 14008 14008 14008 14008 14008 14008 14008 14008 14008 14008
				14008 14008 14008 14008 14008 14008 14008 14008 14008 14008 14008 14008 14008 14008 14008 14008 14008 14008
				14008 14008 14008 14008 14008 14008 14008 14008 14008 14008 14008 14008 14008 14008 14008 14008 14008 14008
				>;

			PS_Config_Lmt_Short_Rawdata_N = <
				11376 11376 11376 11376 11376 11376 11376 11376 11376 11376 11376 11376 11376 11376 11376 11376 11376 11376
				11376 11376 11376 11376 11376 11376 11376 11376 11376 11376 11376 11376 11376 11376 11376 11376 11376 11376
				11376 11376 11376 11376 11376 11376 11376 11376 11376 11376 11376 11376 11376 11376 11376 11376 11376 11376
				11376 11376 11376 11376 11376 11376 11376 11376 11376 11376 11376 11376 11376 11376 11376 11376 11376 11376
				11376 11376 11376 11376 11376 11376 11376 11376 11376 11376 11376 11376 11376 11376 11376 11376 11376 11376
				11376 11376 11376 11376 11376 11376 11376 11376 11376 11376 11376 11376 11376 11376 11376 11376 11376 11376
				11376 11376 11376 11376 11376 11376 11376 11376 11376 11376 11376 11376 11376 11376 11376 11376 11376 11376
				11376 11376 11376 11376 11376 11376 11376 11376 11376 11376 11376 11376 11376 11376 11376 11376 11376 11376
				11376 11376 11376 11376 11376 11376 11376 11376 11376 11376 11376 11376 11376 11376 11376 11376 11376 11376
				11376 11376 11376 11376 11376 11376 11376 11376 11376 11376 11376 11376 11376 11376 11376 11376 11376 11376
				11376 11376 11376 11376 11376 11376 11376 11376 11376 11376 11376 11376 11376 11376 11376 11376 11376 11376
				11376 11376 11376 11376 11376 11376 11376 11376 11376 11376 11376 11376 11376 11376 11376 11376 11376 11376
				11376 11376 11376 11376 11376 11376 11376 11376 11376 11376 11376 11376 11376 11376 11376 11376 11376 11376
				11376 11376 11376 11376 11376 11376 11376 11376 11376 11376 11376 11376 11376 11376 11376 11376 11376 11376
				11376 11376 11376 11376 11376 11376 11376 11376 11376 11376 11376 11376 11376 11376 11376 11376 11376 11376
				11376 11376 11376 11376 11376 11376 11376 11376 11376 11376 11376 11376 11376 11376 11376 11376 11376 11376
				11376 11376 11376 11376 11376 11376 11376 11376 11376 11376 11376 11376 11376 11376 11376 11376 11376 11376
				11376 11376 11376 11376 11376 11376 11376 11376 11376 11376 11376 11376 11376 11376 11376 11376 11376 11376
				11376 11376 11376 11376 11376 11376 11376 11376 11376 11376 11376 11376 11376 11376 11376 11376 11376 11376
				11376 11376 11376 11376 11376 11376 11376 11376 11376 11376 11376 11376 11376 11376 11376 11376 11376 11376
				11376 11376 11376 11376 11376 11376 11376 11376 11376 11376 11376 11376 11376 11376 11376 11376 11376 11376
				11376 11376 11376 11376 11376 11376 11376 11376 11376 11376 11376 11376 11376 11376 11376 11376 11376 11376
				11376 11376 11376 11376 11376 11376 11376 11376 11376 11376 11376 11376 11376 11376 11376 11376 11376 11376
				11376 11376 11376 11376 11376 11376 11376 11376 11376 11376 11376 11376 11376 11376 11376 11376 11376 11376
				11376 11376 11376 11376 11376 11376 11376 11376 11376 11376 11376 11376 11376 11376 11376 11376 11376 11376
				11376 11376 11376 11376 11376 11376 11376 11376 11376 11376 11376 11376 11376 11376 11376 11376 11376 11376
				11376 11376 11376 11376 11376 11376 11376 11376 11376 11376 11376 11376 11376 11376 11376 11376 11376 11376
				11376 11376 11376 11376 11376 11376 11376 11376 11376 11376 11376 11376 11376 11376 11376 11376 11376 11376
				11376 11376 11376 11376 11376 11376 11376 11376 11376 11376 11376 11376 11376 11376 11376 11376 11376 11376
				11376 11376 11376 11376 11376 11376 11376 11376 11376 11376 11376 11376 11376 11376 11376 11376 11376 11376
				11376 11376 11376 11376 11376 11376 11376 11376 11376 11376 11376 11376 11376 11376 11376 11376 11376 11376
				11376 11376 11376 11376 11376 11376 11376 11376 11376 11376 11376 11376 11376 11376 11376 11376 11376 11376
				>;

			
			PS_Config_Lmt_Open_Rawdata_P = <
                2703 2794 2822 2774 65535 65535 65535 65535 65535 65535 65535 65535 65535 65535 2727 2801 2778 2657
                1958 1998 2015 1998 2026 1751 1746 1749 1786 1787 1726 1734 1736 2017 1982 2009 1978 2028
                1921 1949 1956 1941 1993 1956 1969 1963 2007 2002 1929 1944 1925 1957 1917 1941 1918 1975
                1894 1931 1941 1920 1972 1917 1934 1799 1846 1986 1915 1920 1912 1946 1913 1924 1780 1819
                1852 1893 1903 1883 1934 1880 1894 1887 1934 1950 1881 1885 1884 1913 1880 1890 1873 1908
                1892 1933 1944 1924 1975 1917 1932 1930 1978 1986 1918 1922 1921 1950 1915 1924 1914 1949
                1853 1894 1904 1885 1935 1752 1766 1892 1939 1946 1879 1883 1882 1911 1749 1760 1876 1911
                1856 1899 1908 1889 1938 1883 1896 1896 1943 1949 1881 1885 1883 1912 1878 1888 1879 1913
                1858 1902 1910 1889 1937 1889 1902 1899 1945 1949 1881 1885 1879 1909 1882 1892 1880 1913
                1860 1904 1912 1764 1810 1891 1904 1901 1947 1955 1886 1890 1758 1787 1888 1898 1885 1918
                1862 1906 1914 1886 1940 1894 1905 1904 1948 1955 1885 1890 1886 1915 1880 1898 1886 1918
                1871 1903 1917 1892 1946 1903 1913 1913 1956 1956 1883 1888 1889 1918 1876 1900 1880 1920
                1867 1769 1777 1890 1942 1900 1908 1911 1952 1957 1757 1762 1890 1917 1876 1893 1876 1920
                1865 1897 1900 1889 1940 1899 1908 1909 1951 1960 1888 1892 1894 1920 1880 1892 1880 1924
                1864 1903 1907 1893 1944 1903 1911 1913 1955 1957 1892 1896 1895 1921 1881 1893 1881 1925
                1734 1906 1909 1895 1947 1908 1914 1915 1957 1828 1895 1900 1893 1927 1884 1896 1884 1929
                1872 1909 1912 1898 1949 1909 1917 1918 1960 1961 1895 1900 1891 1921 1884 1897 1884 1929
                1874 1907 1911 1897 1948 1907 1916 1916 1959 1973 1903 1907 1900 1928 1892 1905 1892 1935
                1875 1909 1913 1898 1949 1909 1917 1917 1959 1966 1896 1901 1893 1921 1885 1898 1884 1928
                1873 1907 1910 1897 1949 1908 1916 1918 1960 1968 1897 1903 1895 1922 1887 1901 1889 1933
                1879 1914 1918 1903 1963 1912 1920 1925 1968 1968 1898 1904 1895 1923 1884 1898 1890 1933
                1874 1908 1912 1898 1948 1909 1918 1920 1962 1969 1899 1904 1896 1923 1888 1902 1891 1935
                1873 1907 1911 1897 1942 1909 1918 1919 1962 1969 1898 1904 1895 1921 1888 1902 1890 1935
                1873 1907 1911 1894 1939 1909 1918 1919 1962 1968 1898 1903 1891 1918 1886 1901 1890 1934
                1876 1910 1914 1900 1951 1912 1922 1922 1965 1971 1900 1906 1896 1923 1888 1903 1892 1936
                1876 1910 1913 1900 1953 1912 1922 1922 1965 1973 1903 1908 1899 1925 1891 1906 1894 1938
                1877 1908 1912 1901 1948 1914 1923 1924 1967 1973 1900 1906 1900 1926 1892 1907 1895 1940
                1879 1913 1917 1904 1950 1916 1926 1927 1970 1979 1907 1916 1904 1929 1897 1914 1899 1946
                1880 1915 1920 1906 1953 1918 1928 1929 1973 1974 1903 1913 1899 1932 1892 1911 1895 1942
                1909 1945 1952 1935 1992 1948 1961 1959 2006 2007 1936 1949 1933 1969 1925 1948 1928 1982
                2014 2024 2031 2009 2066 2023 2040 2035 2087 2089 2008 2026 2004 2045 1995 2024 2004 2086
                1580 2136 2130 2110 2161 2124 2137 2146 2207 2206 2116 2123 2102 2132 2093 2123 2111 1578
				>;

			PS_Config_Lmt_Open_Rawdata_N = <
				1455 1504 1519 1494 (-65535) (-65535) (-65535) (-65535) (-65535) (-65535) (-65535) (-65535) (-65535) (-65535) 1468 1508 1496 1431
                1054 1076 1085 1076 1091  943  940  942  962  962  929  934  935  1086 1067 1082 1065 1092
                1034 1050 1053 1045 1073 1053 1060 1057 1081 1078 1039 1047 1037 1054 1032 1045 1033 1064
                1020 1040 1045 1034 1062 1032 1041 969  994  1069 1031 1034 1030 1048 1030 1036 959  979
                997  1020 1025 1014 1041 1012 1020 1016 1041 1050 1013 1015 1014 1030 1013 1018 1009 1028
                1019 1041 1047 1036 1063 1032 1040 1039 1065 1069 1033 1035 1034 1050 1031 1036 1031 1050
                998  1020 1025 1015 1042 943  951  1019 1044 1048 1012 1014 1013 1029 942  948  1010 1029
                1000 1022 1027 1017 1044 1014 1021 1021 1046 1050 1013 1015 1014 1030 1011 1017 1012 1030
                1001 1024 1029 1017 1043 1017 1024 1023 1047 1050 1013 1015 1012 1028 1013 1019 1012 1030
                1002 1025 1030 950  975  1018 1025 1024 1048 1053 1015 1018 947  962  1016 1022 1015 1033
                1003 1026 1030 1015 1044 1020 1026 1025 1049 1052 1015 1018 1015 1031 1012 1022 1015 1033
                1007 1025 1032 1019 1048 1025 1030 1030 1053 1053 1014 1016 1017 1033 1010 1023 1012 1034
                1006 953  957  1018 1045 1023 1028 1029 1051 1054  946  949 1018 1032 1010 1019 1010 1034
                1004 1021 1023 1017 1044 1023 1027 1028 1051 1055 1017 1019 1020 1034 1012 1019 1012 1036
                1004 1025 1027 1019 1047 1025 1029 1030 1053 1054 1019 1021 1020 1034 1013 1019 1013 1037
                934  1026 1028 1021 1048 1028 1030 1031 1054 984  1020 1023 1020 1037 1015 1021 1015 1039
                1008 1028 1030 1022 1050 1028 1032 1033 1055 1056 1020 1023 1018 1034 1014 1021 1015 1038
                1009 1027 1029 1022 1049 1027 1032 1032 1055 1062 1025 1027 1023 1038 1019 1026 1019 1042
                1010 1028 1030 1022 1050 1028 1032 1032 1055 1059 1021 1023 1019 1034 1015 1022 1014 1038
                1008 1027 1029 1021 1050 1027 1032 1033 1056 1060 1022 1024 1020 1035 1016 1024 1017 1041
                1012 1030 1033 1025 1057 1029 1034 1037 1060 1060 1022 1025 1021 1036 1015 1022 1018 1041
                1009 1027 1030 1022 1049 1028 1033 1034 1057 1060 1023 1025 1021 1036 1017 1024 1018 1042
                1009 1027 1029 1021 1046 1028 1033 1033 1056 1060 1022 1025 1020 1034 1016 1024 1018 1042
                1009 1027 1029 1020 1044 1028 1033 1033 1057 1060 1022 1025 1018 1033 1016 1024 1018 1041
                1010 1029 1031 1023 1050 1030 1035 1035 1058 1061 1023 1026 1021 1035 1017 1025 1019 1043
                1010 1028 1030 1023 1052 1030 1035 1035 1058 1062 1024 1028 1023 1036 1018 1026 1020 1044
                1010 1027 1029 1024 1049 1030 1036 1036 1059 1063 1023 1026 1023 1037 1019 1027 1021 1045
                1012 1030 1032 1025 1050 1032 1037 1038 1061 1066 1027 1032 1025 1039 1021 1031 1023 1048
                1012 1031 1034 1026 1051 1033 1038 1039 1062 1063 1024 1030 1022 1040 1019 1029 1020 1046
                1028 1047 1051 1042 1072 1049 1056 1055 1080 1081 1042 1050 1041 1060 1036 1049 1038 1067
                1085 1090 1094 1082 1112 1089 1098 1096 1124 1125 1081 1091 1079 1101 1074 1090 1079 1123
                851  1150 1147 1136 1164 1144 1151 1155 1188 1188 1139 1143 1132 1148 1127 1143 1137 850
				>;

			PS_Config_Lmt_FW_Rawdata_P = <
				821	816	825	824 65535 65535 65535 65535 65535 65535 65535 65535 65535 65535 843	827	835	839
                823	806	830	812	829	834	830	833	828	834	849	837	850	835	830	832	827	842
                827	816	833	825	832	827	832	822	831	836	841	837	841	835	839	836	834	847
                828	820	835	829	833	827	831	826	830	837	843	838	843	836	845	835	836	846
                827	821	833	831	831	830	831	827	831	837	847	838	846	836	845	835	836	842
                827	819	832	828	832	831	832	829	832	834	847	838	848	837	847	836	838	844
                827	819	833	825	832	830	832	829	833	834	846	837	847	836	844	838	836	844
                825	819	834	829	833	831	833	826	831	836	845	838	845	836	845	837	835	845
                829	821	834	829	832	828	830	827	832	837	842	838	847	839	843	836	838	846
                828	819	832	828	831	829	833	827	831	837	845	836	846	837	846	836	838	845
                827	820	832	827	833	829	832	829	833	835	846	836	847	837	843	835	839	846
                827	822	833	827	834	830	833	828	832	839	845	838	848	837	843	836	838	846
                830	823	833	828	832	831	834	826	830	836	845	838	848	837	843	835	837	845
                827	821	832	829	832	828	830	828	833	837	847	836	846	835	843	837	840	845
                828	821	832	828	831	830	832	826	831	836	844	836	848	836	844	837	840	846
                829	820	834	828	833	829	831	829	832	839	845	836	847	837	846	839	839	849
                830	823	835	829	833	830	831	827	829	839	846	836	848	838	843	837	839	847
                828	823	835	829	830	829	831	827	830	836	847	835	848	838	846	835	842	849
                828	820	833	828	834	830	832	827	831	839	847	837	849	836	848	838	840	851
                829	821	833	828	836	833	835	825	830	837	850	839	848	840	846	838	843	849
                829	822	835	828	831	829	832	829	831	837	847	839	849	837	847	836	842	851
                830	821	832	828	833	830	831	830	833	836	848	838	850	837	847	840	844	853
                831	823	832	828	833	831	834	827	833	837	847	838	849	841	845	837	842	851
                829	825	837	831	833	831	834	828	831	837	848	839	850	839	847	840	843	852
                829	823	834	829	834	830	833	830	833	839	848	840	850	839	846	838	842	853
                828	825	835	831	833	830	832	831	833	839	847	837	851	840	848	838	844	853
                826	824	834	830	834	834	834	829	835	839	849	840	850	842	849	839	844	851
                830	826	834	834	834	834	834	831	834	839	852	840	854	840	850	840	846	853
                828	824	834	832	834	834	834	829	831	838	849	840	853	840	848	840	845	853
                827	820	834	830	836	831	834	830	834	839	848	840	850	841	846	840	842	850
                829	816	835	825	834	826	832	826	834	839	846	841	847	839	842	840	839	853
                833	827	833	832	834	835	832	833	832	841	853	840	853	840	847	841	848	849
				>;

			PS_Config_Lmt_FW_Rawdata_N = <
				352	350	354	353 (-65535) (-65535) (-65535) (-65535) (-65535) (-65535) (-65535) (-65535) (-65535) (-65535) 361 355 358 360
                353	345	356	348	355	357	356	357	355	357	364	359	364	358	356	357	354	361
                354	350	357	354	357	354	357	352	356	358	360	359	360	358	360	358	358	363
                355	352	358	355	357	354	356	354	356	359	361	359	361	358	362	358	358	363
                354	352	357	356	356	356	356	354	356	359	363	359	362	358	362	358	358	361
                354	351	357	355	357	356	357	355	356	358	363	359	364	359	363	358	359	362
                354	351	357	354	357	356	357	355	357	358	362	359	363	358	362	359	358	362
                354	351	357	355	357	356	357	354	356	358	362	359	362	358	362	359	358	362
                355	352	358	355	356	355	356	355	357	359	361	359	363	359	361	358	359	363
                355	351	357	355	356	355	357	354	356	359	362	358	363	359	362	358	359	362
                354	352	357	355	357	355	357	355	357	358	363	358	363	359	361	358	359	362
                354	352	357	354	357	356	357	355	357	359	362	359	364	359	361	358	359	362
                356	353	357	355	356	356	357	354	356	358	362	359	363	359	361	358	359	362
                354	352	357	355	357	355	356	355	357	359	363	358	363	358	361	359	360	362
                355	352	357	355	356	356	357	354	356	358	362	358	363	358	362	359	360	362
                355	351	357	355	357	355	356	355	356	359	362	358	363	359	362	360	360	364
                356	353	358	355	357	356	356	354	355	360	363	358	364	359	361	359	359	363
                355	353	358	355	356	355	356	355	356	358	363	358	363	359	362	358	361	364
                355	352	357	355	357	356	356	354	356	359	363	359	364	358	363	359	360	365
                355	352	357	355	358	357	358	354	356	359	364	360	363	360	363	359	361	364
                355	352	358	355	356	355	357	355	356	359	363	360	364	359	363	358	361	365
                356	352	357	355	357	356	356	356	357	358	363	359	364	359	363	360	362	366
                356	353	357	355	357	356	357	354	357	359	363	359	364	360	362	359	361	365
                355	353	359	356	357	356	357	355	356	359	364	360	364	360	363	360	361	365
                355	353	357	355	357	356	357	356	357	359	363	360	364	359	363	359	361	365
                355	354	358	356	357	356	357	356	357	360	363	359	365	360	363	359	362	366
                354	353	357	356	357	357	358	355	358	359	364	360	364	361	364	360	362	365
                356	354	358	357	357	357	357	356	357	360	365	360	366	360	364	360	362	366
                355	353	357	357	357	358	357	355	356	359	364	360	365	360	364	360	362	366
                354	351	357	356	358	356	358	356	357	359	363	360	364	360	362	360	361	364
                355	350	358	354	357	354	357	354	357	360	363	360	363	360	361	360	360	366
                357	355	357	357	358	358	357	357	357	360	366	360	366	360	363	361	364	364

				>;

			PS_Config_Lmt_FW_CC_P = <
				148	176	186	180	512	512	512	512	512	512	512	512	512	512	181	188	179	151
                137	134	134	134	135	133	134	134	137	140	137	137	136	138	137	137	137	141
                137	133	133	134	134	134	134	134	137	138	136	135	135	135	135	135	135	139
                138	134	134	134	134	134	134	135	137	138	135	135	135	135	134	133	133	136
                139	135	135	135	135	135	135	136	138	140	137	137	136	137	135	135	134	138
                137	134	134	134	134	134	134	135	137	139	136	136	136	136	135	134	134	138
                139	135	135	135	136	136	136	136	139	141	138	138	137	138	136	136	136	139
                139	136	136	136	136	136	136	137	139	141	138	138	137	138	136	136	136	140
                140	136	136	136	137	137	137	137	140	141	138	138	138	138	136	136	136	140
                140	136	136	136	137	136	137	137	140	143	139	139	139	139	138	138	137	141
                140	136	136	136	137	137	137	137	140	142	139	139	139	139	138	138	137	141
                141	137	137	137	138	137	138	138	141	142	139	139	138	139	138	137	137	141
                141	137	137	137	138	137	137	138	140	142	139	139	138	139	138	138	137	141
                141	137	137	137	137	137	137	138	140	143	140	140	140	140	139	139	139	143
                141	137	137	137	138	138	138	138	141	143	140	140	139	140	139	139	138	143
                142	138	138	138	138	138	138	139	141	143	140	140	140	140	139	139	139	143
                142	138	138	138	138	138	138	139	142	144	141	140	140	140	139	139	139	143
                141	137	137	137	138	138	138	138	141	145	142	142	141	141	140	140	140	145
                142	138	138	138	138	138	138	139	141	144	141	141	141	141	140	140	140	144
                142	138	139	139	139	139	139	139	142	145	142	141	141	141	140	140	140	145
                144	139	139	139	140	140	140	140	143	145	141	141	141	141	140	140	140	145
                142	138	138	138	138	138	138	139	142	145	142	142	141	142	141	141	141	145
                142	138	138	138	139	139	139	139	142	145	142	142	142	142	141	141	141	146
                143	138	138	138	139	139	139	139	142	145	142	142	141	141	140	140	140	145
                143	138	139	139	139	139	139	140	142	145	142	142	141	141	140	140	140	145
                142	138	138	138	139	139	139	139	142	146	142	142	142	142	141	141	141	146
                143	138	138	139	139	139	139	140	142	145	142	142	142	142	141	141	141	146
                144	139	139	139	139	139	140	140	142	145	142	142	142	142	141	141	141	146
                143	139	139	139	139	139	139	140	142	146	142	142	142	142	141	141	141	146
                144	139	139	139	139	139	139	140	142	147	144	143	143	143	142	143	142	148
                146	140	140	140	140	140	140	141	144	148	144	144	144	144	143	143	143	149
                139	144	142	141	142	142	142	142	146	149	145	145	145	145	144	145	147	141
				>;

			PS_Config_Lmt_FW_CC_N = <
				80	80	80	80	0	0	0	0	0	0	0	0	0	0	80	80	80	80
                80	80	80	80	80	80	80	80	80	80	80	80	80	80	80	80	80	80
                80	80	80	80	80	80	80	80	80	80	80	80	80	80	80	80	80	80
                80	80	80	80	80	80	80	80	80	80	80	80	80	80	80	80	80	80
                80	80	80	80	80	80	80	80	80	80	80	80	80	80	80	80	80	80
                80	80	80	80	80	80	80	80	80	80	80	80	80	80	80	80	80	80
                80	80	80	80	80	80	80	80	80	80	80	80	80	80	80	80	80	80
                80	80	80	80	80	80	80	80	80	80	80	80	80	80	80	80	80	80
                80	80	80	80	80	80	80	80	80	80	80	80	80	80	80	80	80	80
                80	80	80	80	80	80	80	80	80	80	80	80	80	80	80	80	80	80
                80	80	80	80	80	80	80	80	80	80	80	80	80	80	80	80	80	80
                80	80	80	80	80	80	80	80	80	80	80	80	80	80	80	80	80	80
                80	80	80	80	80	80	80	80	80	80	80	80	80	80	80	80	80	80
                80	80	80	80	80	80	80	80	80	80	80	80	80	80	80	80	80	80
                80	80	80	80	80	80	80	80	80	80	80	80	80	80	80	80	80	80
                80	80	80	80	80	80	80	80	80	80	80	80	80	80	80	80	80	80
                80	80	80	80	80	80	80	80	80	80	80	80	80	80	80	80	80	80
                80	80	80	80	80	80	80	80	80	80	80	80	80	80	80	80	80	80
                80	80	80	80	80	80	80	80	80	80	80	80	80	80	80	80	80	80
                80	80	80	80	80	80	80	80	80	80	80	80	80	80	80	80	80	80
                80	80	80	80	80	80	80	80	80	80	80	80	80	80	80	80	80	80
                80	80	80	80	80	80	80	80	80	80	80	80	80	80	80	80	80	80
                80	80	80	80	80	80	80	80	80	80	80	80	80	80	80	80	80	80
                80	80	80	80	80	80	80	80	80	80	80	80	80	80	80	80	80	80
                80	80	80	80	80	80	80	80	80	80	80	80	80	80	80	80	80	80
                80	80	80	80	80	80	80	80	80	80	80	80	80	80	80	80	80	80
                80	80	80	80	80	80	80	80	80	80	80	80	80	80	80	80	80	80
                80	80	80	80	80	80	80	80	80	80	80	80	80	80	80	80	80	80
                80	80	80	80	80	80	80	80	80	80	80	80	80	80	80	80	80	80
                80	80	80	80	80	80	80	80	80	80	80	80	80	80	80	80	80	80
                80	80	80	80	80	80	80	80	80	80	80	80	80	80	80	80	80	80
                80	80	80	80	80	80	80	80	80	80	80	80	80	80	80	80	80	80
				>;

			PS_Config_Lmt_FW_Diff_P = <
				35 35 35 35 65535 65535 65535 65535 65535 65535 65535 65535 65535 65535 35 35 35 35
				35 35 35 35 35 35 35 35 35 35 35 35 35 35 35 35 35 35
				35 35 35 35 35 35 35 35 35 35 35 35 35 35 35 35 35 35
				35 35 35 35 35 35 35 35 35 35 35 35 35 35 35 35 35 35
				35 35 35 35 35 35 35 35 35 35 35 35 35 35 35 35 35 35
				35 35 35 35 35 35 35 35 35 35 35 35 35 35 35 35 35 35
				35 35 35 35 35 35 35 35 35 35 35 35 35 35 35 35 35 35
				35 35 35 35 35 35 35 35 35 35 35 35 35 35 35 35 35 35
				35 35 35 35 35 35 35 35 35 35 35 35 35 35 35 35 35 35
				35 35 35 35 35 35 35 35 35 35 35 35 35 35 35 35 35 35
				35 35 35 35 35 35 35 35 35 35 35 35 35 35 35 35 35 35
				35 35 35 35 35 35 35 35 35 35 35 35 35 35 35 35 35 35
				35 35 35 35 35 35 35 35 35 35 35 35 35 35 35 35 35 35
				35 35 35 35 35 35 35 35 35 35 35 35 35 35 35 35 35 35
				35 35 35 35 35 35 35 35 35 35 35 35 35 35 35 35 35 35
				35 35 35 35 35 35 35 35 35 35 35 35 35 35 35 35 35 35
				35 35 35 35 35 35 35 35 35 35 35 35 35 35 35 35 35 35
				35 35 35 35 35 35 35 35 35 35 35 35 35 35 35 35 35 35
				35 35 35 35 35 35 35 35 35 35 35 35 35 35 35 35 35 35
				35 35 35 35 35 35 35 35 35 35 35 35 35 35 35 35 35 35
				35 35 35 35 35 35 35 35 35 35 35 35 35 35 35 35 35 35
				35 35 35 35 35 35 35 35 35 35 35 35 35 35 35 35 35 35
				35 35 35 35 35 35 35 35 35 35 35 35 35 35 35 35 35 35
				35 35 35 35 35 35 35 35 35 35 35 35 35 35 35 35 35 35
				35 35 35 35 35 35 35 35 35 35 35 35 35 35 35 35 35 35
				35 35 35 35 35 35 35 35 35 35 35 35 35 35 35 35 35 35
				35 35 35 35 35 35 35 35 35 35 35 35 35 35 35 35 35 35
				35 35 35 35 35 35 35 35 35 35 35 35 35 35 35 35 35 35
				35 35 35 35 35 35 35 35 35 35 35 35 35 35 35 35 35 35
				35 35 35 35 35 35 35 35 35 35 35 35 35 35 35 35 35 35
				35 35 35 35 35 35 35 35 35 35 35 35 35 35 35 35 35 35
				35 35 35 35 35 35 35 35 35 35 35 35 35 35 35 35 35 35
				35 35 35>;

			PS_Config_Lmt_FW_Diff_N = <
				(-35) (-35) (-35) (-35)  (-65535) (-65535) (-65535) (-65535) (-65535) (-65535) (-65535) (-65535) (-65535) (-65535) (-35) (-35) (-35) (-35)
				(-35) (-35) (-35) (-35) (-35) (-35) (-35) (-35) (-35) (-35) (-35) (-35) (-35) (-35) (-35) (-35) (-35) (-35)
				(-35) (-35) (-35) (-35) (-35) (-35) (-35) (-35) (-35) (-35) (-35) (-35) (-35) (-35) (-35) (-35) (-35) (-35)
				(-35) (-35) (-35) (-35) (-35) (-35) (-35) (-35) (-35) (-35) (-35) (-35) (-35) (-35) (-35) (-35) (-35) (-35)
				(-35) (-35) (-35) (-35) (-35) (-35) (-35) (-35) (-35) (-35) (-35) (-35) (-35) (-35) (-35) (-35) (-35) (-35)
				(-35) (-35) (-35) (-35) (-35) (-35) (-35) (-35) (-35) (-35) (-35) (-35) (-35) (-35) (-35) (-35) (-35) (-35)
				(-35) (-35) (-35) (-35) (-35) (-35) (-35) (-35) (-35) (-35) (-35) (-35) (-35) (-35) (-35) (-35) (-35) (-35)
				(-35) (-35) (-35) (-35) (-35) (-35) (-35) (-35) (-35) (-35) (-35) (-35) (-35) (-35) (-35) (-35) (-35) (-35)
				(-35) (-35) (-35) (-35) (-35) (-35) (-35) (-35) (-35) (-35) (-35) (-35) (-35) (-35) (-35) (-35) (-35) (-35)
				(-35) (-35) (-35) (-35) (-35) (-35) (-35) (-35) (-35) (-35) (-35) (-35) (-35) (-35) (-35) (-35) (-35) (-35)
				(-35) (-35) (-35) (-35) (-35) (-35) (-35) (-35) (-35) (-35) (-35) (-35) (-35) (-35) (-35) (-35) (-35) (-35)
				(-35) (-35) (-35) (-35) (-35) (-35) (-35) (-35) (-35) (-35) (-35) (-35) (-35) (-35) (-35) (-35) (-35) (-35)
				(-35) (-35) (-35) (-35) (-35) (-35) (-35) (-35) (-35) (-35) (-35) (-35) (-35) (-35) (-35) (-35) (-35) (-35)
				(-35) (-35) (-35) (-35) (-35) (-35) (-35) (-35) (-35) (-35) (-35) (-35) (-35) (-35) (-35) (-35) (-35) (-35)
				(-35) (-35) (-35) (-35) (-35) (-35) (-35) (-35) (-35) (-35) (-35) (-35) (-35) (-35) (-35) (-35) (-35) (-35)
				(-35) (-35) (-35) (-35) (-35) (-35) (-35) (-35) (-35) (-35) (-35) (-35) (-35) (-35) (-35) (-35) (-35) (-35)
				(-35) (-35) (-35) (-35) (-35) (-35) (-35) (-35) (-35) (-35) (-35) (-35) (-35) (-35) (-35) (-35) (-35) (-35)
				(-35) (-35) (-35) (-35) (-35) (-35) (-35) (-35) (-35) (-35) (-35) (-35) (-35) (-35) (-35) (-35) (-35) (-35)
				(-35) (-35) (-35) (-35) (-35) (-35) (-35) (-35) (-35) (-35) (-35) (-35) (-35) (-35) (-35) (-35) (-35) (-35)
				(-35) (-35) (-35) (-35) (-35) (-35) (-35) (-35) (-35) (-35) (-35) (-35) (-35) (-35) (-35) (-35) (-35) (-35)
				(-35) (-35) (-35) (-35) (-35) (-35) (-35) (-35) (-35) (-35) (-35) (-35) (-35) (-35) (-35) (-35) (-35) (-35)
				(-35) (-35) (-35) (-35) (-35) (-35) (-35) (-35) (-35) (-35) (-35) (-35) (-35) (-35) (-35) (-35) (-35) (-35)
				(-35) (-35) (-35) (-35) (-35) (-35) (-35) (-35) (-35) (-35) (-35) (-35) (-35) (-35) (-35) (-35) (-35) (-35)
				(-35) (-35) (-35) (-35) (-35) (-35) (-35) (-35) (-35) (-35) (-35) (-35) (-35) (-35) (-35) (-35) (-35) (-35)
				(-35) (-35) (-35) (-35) (-35) (-35) (-35) (-35) (-35) (-35) (-35) (-35) (-35) (-35) (-35) (-35) (-35) (-35)
				(-35) (-35) (-35) (-35) (-35) (-35) (-35) (-35) (-35) (-35) (-35) (-35) (-35) (-35) (-35) (-35) (-35) (-35)
				(-35) (-35) (-35) (-35) (-35) (-35) (-35) (-35) (-35) (-35) (-35) (-35) (-35) (-35) (-35) (-35) (-35) (-35)
				(-35) (-35) (-35) (-35) (-35) (-35) (-35) (-35) (-35) (-35) (-35) (-35) (-35) (-35) (-35) (-35) (-35) (-35)
				(-35) (-35) (-35) (-35) (-35) (-35) (-35) (-35) (-35) (-35) (-35) (-35) (-35) (-35) (-35) (-35) (-35) (-35)
				(-35) (-35) (-35) (-35) (-35) (-35) (-35) (-35) (-35) (-35) (-35) (-35) (-35) (-35) (-35) (-35) (-35) (-35)
				(-35) (-35) (-35) (-35) (-35) (-35) (-35) (-35) (-35) (-35) (-35) (-35) (-35) (-35) (-35) (-35) (-35) (-35)
				(-35) (-35) (-35) (-35) (-35) (-35) (-35) (-35) (-35) (-35) (-35) (-35) (-35) (-35) (-35) (-35) (-35) (-35)
				(-35) (-35) (-35)>;

			PS_Config_Diff_Test_Frame = <50>;
		};

		novatek-mp-criteria-5106@0 {
			#address-cells = <1>;
			#size-cells = <0>;
			compatible = "novatek-mp-criteria-5106";//5106 is pid of Truly586	;5105 is pid of TM586

			/* MP Config */
			IC_X_CFG_SIZE = <18>;
			IC_Y_CFG_SIZE = <32>;
			IC_KEY_CFG_SIZE = <4>;
			X_Channel = <18>;
			Y_Channel = <32>;
			AIN_X = <0 1 2 3 4 5 6 7 8 9 10 11 12 13 14 15 16 17>;
			AIN_Y = <0 1 2 3 4 5 6 7 8 9 10 11 12 13 14 15 16 17 18 19 20 21 22 23 24 25 26 27 28 29 30 31>;
			AIN_KEY = <0 1 2 0xFF>;

			/* MP Criteria */
			PS_Config_Lmt_Short_Rawdata_P = <
				14008 14008 14008 14008 14008 14008 14008 14008 14008 14008 14008 14008 14008 14008 14008 14008 14008 14008
				14008 14008 14008 14008 14008 14008 14008 14008 14008 14008 14008 14008 14008 14008 14008 14008 14008 14008
				14008 14008 14008 14008 14008 14008 14008 14008 14008 14008 14008 14008 14008 14008 14008 14008 14008 14008
				14008 14008 14008 14008 14008 14008 14008 14008 14008 14008 14008 14008 14008 14008 14008 14008 14008 14008
				14008 14008 14008 14008 14008 14008 14008 14008 14008 14008 14008 14008 14008 14008 14008 14008 14008 14008
				14008 14008 14008 14008 14008 14008 14008 14008 14008 14008 14008 14008 14008 14008 14008 14008 14008 14008
				14008 14008 14008 14008 14008 14008 14008 14008 14008 14008 14008 14008 14008 14008 14008 14008 14008 14008
				14008 14008 14008 14008 14008 14008 14008 14008 14008 14008 14008 14008 14008 14008 14008 14008 14008 14008
				14008 14008 14008 14008 14008 14008 14008 14008 14008 14008 14008 14008 14008 14008 14008 14008 14008 14008
				14008 14008 14008 14008 14008 14008 14008 14008 14008 14008 14008 14008 14008 14008 14008 14008 14008 14008
				14008 14008 14008 14008 14008 14008 14008 14008 14008 14008 14008 14008 14008 14008 14008 14008 14008 14008
				14008 14008 14008 14008 14008 14008 14008 14008 14008 14008 14008 14008 14008 14008 14008 14008 14008 14008
				14008 14008 14008 14008 14008 14008 14008 14008 14008 14008 14008 14008 14008 14008 14008 14008 14008 14008
				14008 14008 14008 14008 14008 14008 14008 14008 14008 14008 14008 14008 14008 14008 14008 14008 14008 14008
				14008 14008 14008 14008 14008 14008 14008 14008 14008 14008 14008 14008 14008 14008 14008 14008 14008 14008
				14008 14008 14008 14008 14008 14008 14008 14008 14008 14008 14008 14008 14008 14008 14008 14008 14008 14008
				14008 14008 14008 14008 14008 14008 14008 14008 14008 14008 14008 14008 14008 14008 14008 14008 14008 14008
				14008 14008 14008 14008 14008 14008 14008 14008 14008 14008 14008 14008 14008 14008 14008 14008 14008 14008
				14008 14008 14008 14008 14008 14008 14008 14008 14008 14008 14008 14008 14008 14008 14008 14008 14008 14008
				14008 14008 14008 14008 14008 14008 14008 14008 14008 14008 14008 14008 14008 14008 14008 14008 14008 14008
				14008 14008 14008 14008 14008 14008 14008 14008 14008 14008 14008 14008 14008 14008 14008 14008 14008 14008
				14008 14008 14008 14008 14008 14008 14008 14008 14008 14008 14008 14008 14008 14008 14008 14008 14008 14008
				14008 14008 14008 14008 14008 14008 14008 14008 14008 14008 14008 14008 14008 14008 14008 14008 14008 14008
				14008 14008 14008 14008 14008 14008 14008 14008 14008 14008 14008 14008 14008 14008 14008 14008 14008 14008
				14008 14008 14008 14008 14008 14008 14008 14008 14008 14008 14008 14008 14008 14008 14008 14008 14008 14008
				14008 14008 14008 14008 14008 14008 14008 14008 14008 14008 14008 14008 14008 14008 14008 14008 14008 14008
				14008 14008 14008 14008 14008 14008 14008 14008 14008 14008 14008 14008 14008 14008 14008 14008 14008 14008
				14008 14008 14008 14008 14008 14008 14008 14008 14008 14008 14008 14008 14008 14008 14008 14008 14008 14008
				14008 14008 14008 14008 14008 14008 14008 14008 14008 14008 14008 14008 14008 14008 14008 14008 14008 14008
				14008 14008 14008 14008 14008 14008 14008 14008 14008 14008 14008 14008 14008 14008 14008 14008 14008 14008
				14008 14008 14008 14008 14008 14008 14008 14008 14008 14008 14008 14008 14008 14008 14008 14008 14008 14008
				14008 14008 14008 14008 14008 14008 14008 14008 14008 14008 14008 14008 14008 14008 14008 14008 14008 14008
				>;

			PS_Config_Lmt_Short_Rawdata_N = <
				11376 11376 11376 11376 11376 11376 11376 11376 11376 11376 11376 11376 11376 11376 11376 11376 11376 11376
				11376 11376 11376 11376 11376 11376 11376 11376 11376 11376 11376 11376 11376 11376 11376 11376 11376 11376
				11376 11376 11376 11376 11376 11376 11376 11376 11376 11376 11376 11376 11376 11376 11376 11376 11376 11376
				11376 11376 11376 11376 11376 11376 11376 11376 11376 11376 11376 11376 11376 11376 11376 11376 11376 11376
				11376 11376 11376 11376 11376 11376 11376 11376 11376 11376 11376 11376 11376 11376 11376 11376 11376 11376
				11376 11376 11376 11376 11376 11376 11376 11376 11376 11376 11376 11376 11376 11376 11376 11376 11376 11376
				11376 11376 11376 11376 11376 11376 11376 11376 11376 11376 11376 11376 11376 11376 11376 11376 11376 11376
				11376 11376 11376 11376 11376 11376 11376 11376 11376 11376 11376 11376 11376 11376 11376 11376 11376 11376
				11376 11376 11376 11376 11376 11376 11376 11376 11376 11376 11376 11376 11376 11376 11376 11376 11376 11376
				11376 11376 11376 11376 11376 11376 11376 11376 11376 11376 11376 11376 11376 11376 11376 11376 11376 11376
				11376 11376 11376 11376 11376 11376 11376 11376 11376 11376 11376 11376 11376 11376 11376 11376 11376 11376
				11376 11376 11376 11376 11376 11376 11376 11376 11376 11376 11376 11376 11376 11376 11376 11376 11376 11376
				11376 11376 11376 11376 11376 11376 11376 11376 11376 11376 11376 11376 11376 11376 11376 11376 11376 11376
				11376 11376 11376 11376 11376 11376 11376 11376 11376 11376 11376 11376 11376 11376 11376 11376 11376 11376
				11376 11376 11376 11376 11376 11376 11376 11376 11376 11376 11376 11376 11376 11376 11376 11376 11376 11376
				11376 11376 11376 11376 11376 11376 11376 11376 11376 11376 11376 11376 11376 11376 11376 11376 11376 11376
				11376 11376 11376 11376 11376 11376 11376 11376 11376 11376 11376 11376 11376 11376 11376 11376 11376 11376
				11376 11376 11376 11376 11376 11376 11376 11376 11376 11376 11376 11376 11376 11376 11376 11376 11376 11376
				11376 11376 11376 11376 11376 11376 11376 11376 11376 11376 11376 11376 11376 11376 11376 11376 11376 11376
				11376 11376 11376 11376 11376 11376 11376 11376 11376 11376 11376 11376 11376 11376 11376 11376 11376 11376
				11376 11376 11376 11376 11376 11376 11376 11376 11376 11376 11376 11376 11376 11376 11376 11376 11376 11376
				11376 11376 11376 11376 11376 11376 11376 11376 11376 11376 11376 11376 11376 11376 11376 11376 11376 11376
				11376 11376 11376 11376 11376 11376 11376 11376 11376 11376 11376 11376 11376 11376 11376 11376 11376 11376
				11376 11376 11376 11376 11376 11376 11376 11376 11376 11376 11376 11376 11376 11376 11376 11376 11376 11376
				11376 11376 11376 11376 11376 11376 11376 11376 11376 11376 11376 11376 11376 11376 11376 11376 11376 11376
				11376 11376 11376 11376 11376 11376 11376 11376 11376 11376 11376 11376 11376 11376 11376 11376 11376 11376
				11376 11376 11376 11376 11376 11376 11376 11376 11376 11376 11376 11376 11376 11376 11376 11376 11376 11376
				11376 11376 11376 11376 11376 11376 11376 11376 11376 11376 11376 11376 11376 11376 11376 11376 11376 11376
				11376 11376 11376 11376 11376 11376 11376 11376 11376 11376 11376 11376 11376 11376 11376 11376 11376 11376
				11376 11376 11376 11376 11376 11376 11376 11376 11376 11376 11376 11376 11376 11376 11376 11376 11376 11376
				11376 11376 11376 11376 11376 11376 11376 11376 11376 11376 11376 11376 11376 11376 11376 11376 11376 11376
				11376 11376 11376 11376 11376 11376 11376 11376 11376 11376 11376 11376 11376 11376 11376 11376 11376 11376
				>;


			PS_Config_Lmt_Open_Rawdata_P = <
                	2903	2889	2916	2893	65535	65535	65535	65535	65535	65535	65535	65535	65535	65535	2846	2874	2844	2847
					1884	2045	2062	2062	2059	1748	1738	1740	1733	1731	1737	1738	1744	2049	2055	2059	2042	1877
					1801	1939	1953	1955	1958	1944	1946	1947	1941	1932	1939	1936	1936	1947	1947	1950	1940	1799
					1765	1936	1948	1947	1941	1901	1899	1899	1905	1904	1904	1968	1902	1940	2025	1937	1919	1776
					1733	1919	1932	1950	1926	1884	1881	1885	1887	1891	1957	1888	1890	2018	1948	1929	1995	1730
					1743	1946	1940	1957	1957	1891	1888	1892	1894	1969	1901	1897	1968	1962	1958	2024	1941	1740
					1737	1940	1954	1948	1947	1877	1877	1881	1881	1890	1887	1885	1890	1951	1941	1943	1930	1729
					1741	1941	1957	1954	1954	1890	1887	1890	1888	1888	1888	1885	1888	1951	1948	1950	1933	1734
					1619	1776	1787	1790	1790	1751	1750	1751	1750	1759	1759	1757	1757	1794	1792	1789	1773	1618
					1625	1778	1789	1792	1790	1752	1751	1751	1751	1755	1755	1752	1752	1790	1789	1787	1772	1615
					1625	1779	1790	1786	1785	1748	1747	1747	1745	1759	1761	1758	1759	1787	1776	1794	1780	1628
					1625	1772	1787	1768	1778	1750	1750	1751	1750	1758	1759	1758	1759	1785	1776	1796	1764	1629
					1635	1765	1790	1773	1780	1755	1755	1755	1754	1761	1764	1762	1764	1789	1782	1783	1768	1632
					1636	1768	1780	1780	1785	1759	1761	1761	1758	1758	1759	1761	1762	1785	1780	1780	1768	1632
					1642	1775	1787	1786	1789	1766	1765	1765	1762	1757	1759	1758	1759	1780	1776	1776	1766	1631
					1647	1780	1790	1790	1790	1768	1768	1769	1765	1762	1764	1765	1766	1786	1785	1786	1773	1639
					1646	1779	1790	1792	1792	1771	1771	1769	1766	1775	1778	1778	1778	1797	1796	1797	1786	1649
					1652	1786	1796	1794	1793	1773	1773	1773	1769	1771	1773	1772	1775	1794	1794	1796	1785	1650
					1645	1776	1787	1786	1786	1768	1769	1768	1765	1766	1768	1766	1768	1786	1786	1789	1778	1643
					1646	1779	1789	1790	1787	1769	1769	1768	1765	1778	1780	1780	1780	1800	1803	1804	1793	1656
					1652	1786	1796	1797	1794	1778	1778	1776	1773	1773	1775	1775	1775	1792	1796	1799	1789	1650
					1650	1785	1794	1794	1792	1775	1776	1776	1773	1775	1778	1778	1779	1797	1800	1803	1793	1652
					1659	1794	1806	1804	1800	1782	1783	1782	1779	1775	1778	1779	1779	1797	1801	1804	1794	1653
					1661	1799	1808	1808	1806	1786	1787	1787	1783	1782	1786	1786	1787	1804	1808	1810	1803	1659
					1656	1793	1804	1806	1801	1783	1783	1783	1779	1773	1778	1778	1780	1799	1803	1806	1797	1654
					1661	1800	1811	1811	1807	1789	1789	1789	1785	1778	1783	1783	1786	1804	1808	1811	1803	1657
					1660	1797	1807	1807	1803	1786	1786	1785	1779	1780	1785	1786	1787	1806	1810	1813	1804	1661
					1656	1793	1803	1803	1800	1782	1782	1783	1779	1783	1789	1787	1789	1807	1811	1815	1807	1664
					1657	1796	1807	1806	1801	1785	1785	1783	1780	1785	1789	1789	1790	1810	1815	1818	1810	1670
					1691	1831	1839	1841	1836	1818	1817	1815	1814	1814	1820	1820	1822	1841	1848	1850	1843	1699
					1724	1898	1913	1916	1912	1891	1891	1891	1885	1885	1897	1897	1898	1918	1923	1925	1911	1734
					1384	1946	1986	2003	2003	1982	1982	1979	1967	1965	1978	1979	1981	2002	2004	1992	1951	1381
				>;

			PS_Config_Lmt_Open_Rawdata_N = <
				1244	1238	1249	1240	(-65535)	(-65535)	(-65535)	(-65535)	(-65535)	(-65535)	(-65535)	(-65535)	(-65535)	(-65535)	1219	1231	1219	1220
				807	876	883	883	882	749	745	745	742	742	744	745	747	878	880	882	875	804
				772	831	837	838	839	833	834	834	832	828	831	829	829	834	834	835	831	771
				756	829	835	834	832	814	814	814	816	816	816	843	815	831	868	830	822	761
				742	822	828	835	825	807	806	808	808	810	838	809	810	865	835	826	855	741
				747	834	831	838	838	810	809	811	811	844	814	813	843	841	839	867	832	745
				744	831	837	835	834	804	804	806	806	810	808	808	810	836	832	832	827	741
				746	832	838	837	837	810	808	810	809	809	809	808	809	836	835	835	828	743
				694	761	766	767	767	750	750	750	750	754	754	753	753	769	768	766	760	693
				696	762	766	768	767	751	750	750	750	752	752	751	751	767	766	766	759	692
				696	762	767	765	765	749	748	748	748	754	754	753	754	766	761	769	763	697
				696	759	766	757	762	750	750	750	750	753	754	753	754	765	761	769	756	698
				700	756	767	760	763	752	752	752	751	754	756	755	756	766	763	764	757	699
				701	757	763	763	765	754	754	754	753	753	754	754	755	765	763	763	757	699
				703	760	766	765	766	757	756	756	755	753	754	753	754	763	761	761	757	699
				706	763	767	767	767	757	757	758	756	755	756	756	757	765	765	765	760	702
				705	762	767	768	768	759	759	758	757	760	762	762	762	770	769	770	765	706
				708	765	769	769	768	760	760	760	758	759	760	759	760	769	769	769	765	707
				705	761	766	765	765	757	758	757	756	757	757	757	757	765	765	766	762	704
				705	762	766	767	766	758	758	757	756	762	763	763	763	771	772	773	768	709
				708	765	769	770	769	762	762	761	760	760	760	760	760	768	769	771	766	707
				707	765	769	769	768	760	761	761	760	760	762	762	762	770	771	772	768	708
				711	769	774	773	771	763	764	763	762	760	762	762	762	770	772	773	769	708
				712	771	775	775	774	765	766	766	764	763	765	765	766	773	775	775	772	711
				709	768	773	774	772	764	764	764	762	760	762	762	763	771	772	774	770	709
				712	771	776	776	774	766	766	766	765	762	764	764	765	773	775	776	772	710
				711	770	774	774	772	765	765	765	762	763	765	765	766	774	775	777	773	712
				709	768	772	772	771	763	763	764	762	764	766	766	766	774	776	778	774	713
				710	769	774	774	772	765	765	764	763	765	766	766	767	775	778	779	775	715
				724	784	788	789	787	779	778	778	777	777	780	780	781	789	792	793	790	728
				739	813	820	821	819	810	810	810	808	808	813	813	813	822	824	825	819	743
				593	834	851	858	858	849	849	848	843	842	847	848	849	858	859	853	836	592
				>;

			PS_Config_Lmt_FW_Rawdata_P = <
				1614	1622	1667	1699	65535	65535	65535	65535	65535	65535	65535	65535	65535	65535	1598	1687	1659	1706
				1673	1607	1628	1635	1652	1699	1701	1745	1685	1633	1633	1603	1759	1716	1730	1759	1764	1688
				1691	1617	1629	1647	1617	1593	1605	1661	1642	1705	1653	1611	1740	1717	1597	1615	1631	1737
				1580	1705	1663	1652	1640	1654	1661	1734	1681	1638	1618	1643	1696	1671	1705	1621	1635	1780
				1680	1747	1709	1696	1661	1667	1681	1754	1692	1600	1684	1729	1680	1706	1652	1632	1701	1794
				1681	1596	1740	1722	1706	1713	1722	1593	1727	1638	1723	1674	1702	1579	1594	1647	1589	1722
				1612	1705	1701	1671	1635	1675	1667	1710	1671	1715	1715	1663	1626	1761	1587	1764	1740	1684
				1751	1660	1654	1625	1766	1625	1625	1678	1643	1650	1619	1752	1703	1656	1681	1657	1639	1780
				1660	1638	1629	1614	1758	1611	1615	1666	1657	1660	1628	1747	1703	1657	1682	1652	1633	1706
				1649	1636	1614	1596	1741	1591	1594	1649	1652	1765	1713	1645	1608	1745	1761	1740	1723	1778
				1743	1723	1705	1698	1670	1698	1701	1768	1769	1685	1636	1772	1733	1684	1702	1664	1656	1730
				1646	1610	1600	1587	1745	1586	1586	1649	1654	1740	1689	1635	1600	1740	1743	1706	1699	1779
				1598	1752	1752	1737	1688	1719	1716	1589	1584	1625	1750	1702	1661	1601	1633	1622	1604	1691
				1713	1682	1687	1661	1618	1652	1656	1730	1713	1584	1754	1696	1650	1596	1628	1607	1766	1678
				1608	1757	1759	1731	1684	1715	1723	1615	1597	1779	1743	1688	1636	1590	1631	1610	1768	1682
				1594	1737	1751	1726	1685	1715	1738	1618	1589	1723	1689	1635	1769	1726	1584	1733	1715	1626
				1722	1682	1689	1673	1618	1631	1661	1740	1722	1762	1715	1661	1600	1754	1605	1573	1759	1652
				1603	1736	1744	1733	1680	1695	1716	1601	1594	1617	1573	1705	1661	1633	1652	1638	1625	1731
				1702	1654	1671	1650	1608	1631	1646	1723	1708	1661	1639	1750	1713	1671	1708	1702	1680	1786
				1703	1643	1657	1645	1611	1640	1640	1716	1702	1712	1681	1626	1769	1727	1772	1769	1762	1677
				1586	1708	1730	1709	1694	1710	1720	1608	1584	1715	1682	1611	1769	1736	1761	1591	1766	1680
				1604	1719	1744	1720	1681	1702	1710	1598	1761	1626	1576	1712	1687	1638	1681	1702	1687	1607
				1575	1694	1702	1691	1659	1675	1685	1747	1705	1666	1652	1601	1744	1713	1757	1769	1765	1682
				1691	1608	1625	1610	1766	1612	1615	1667	1621	1759	1738	1694	1654	1617	1666	1670	1663	1766
				1688	1618	1636	1633	1590	1607	1622	1668	1615	1660	1635	1778	1738	1710	1743	1740	1731	1666
				1610	1726	1724	1710	1689	1712	1723	1775	1716	1717	1701	1654	1619	1582	1618	1626	1622	1734
				1642	1744	1757	1738	1706	1723	1731	1607	1724	1731	1710	1675	1642	1594	1631	1632	1636	1757
				1633	1744	1743	1722	1698	1712	1729	1757	1719	1719	1671	1643	1612	1762	1605	1610	1622	1730
				1740	1680	1677	1663	1626	1650	1668	1698	1657	1740	1701	1681	1624	1597	1640	1642	1657	1754
				1674	1614	1612	1603	1757	1584	1607	1647	1591	1610	1580	1751	1694	1663	1695	1687	1696	1621
				1617	1593	1603	1593	1759	1589	1603	1635	1625	1642	1750	1733	1670	1633	1674	1660	1659	1708
				1712	1726	1701	1719	1632	1649	1678	1631	1685	1741	1762	1608	1706	1666	1582	1591	1611	1654
				>;

			PS_Config_Lmt_FW_Rawdata_N = <
				691	695	714	728	(-65535)	(-65535)	(-65535)	(-65535)	(-65535)	(-65535)	(-65535)	(-65535)	(-65535)	(-65535)	685	723	711	731
				717	688	697	700	708	728	729	748	722	700	700	687	754	735	741	754	756	723
				724	693	698	706	693	682	688	712	703	730	708	690	745	736	684	692	699	744
				677	730	712	708	703	709	712	743	720	702	693	704	727	716	730	694	700	763
				720	748	732	727	712	714	720	751	725	685	721	741	720	731	708	699	729	769
				720	684	745	738	731	734	738	682	740	702	738	717	729	676	683	706	681	738
				691	730	729	716	700	718	714	733	716	735	735	712	697	754	680	756	745	721
				750	711	709	696	757	696	696	719	704	707	694	751	730	709	720	710	702	763
				711	702	698	691	753	690	692	714	710	711	697	748	730	710	721	708	700	731
				706	701	691	684	746	682	683	706	708	756	734	705	689	748	754	745	738	762
				747	738	730	727	715	727	729	757	758	722	701	759	742	721	729	713	709	741
				705	690	685	680	748	679	679	706	709	745	724	700	685	745	747	731	728	762
				685	751	751	744	723	736	735	681	679	696	750	729	712	686	700	695	687	724
				734	721	723	712	693	708	709	741	734	679	751	727	707	684	697	688	757	719
				689	753	754	742	721	735	738	692	684	762	747	723	701	681	699	690	757	721
				683	744	750	739	722	735	745	693	681	738	724	700	758	739	679	742	735	697
				738	721	724	717	693	699	712	745	738	755	735	712	685	751	688	674	754	708
				687	744	747	742	720	726	735	686	683	693	674	730	712	700	708	702	696	742
				729	709	716	707	689	699	705	738	732	712	702	750	734	716	732	729	720	765
				730	704	710	705	690	703	703	735	729	733	720	697	758	740	759	758	755	718
				679	732	741	732	726	733	737	689	679	735	721	690	758	744	754	682	757	720
				687	736	747	737	720	729	733	685	754	697	675	733	723	702	720	729	723	688
				675	726	729	724	711	718	722	748	730	714	708	686	747	734	753	758	756	721
				724	689	696	690	757	691	692	714	694	754	745	726	709	693	714	715	712	757
				723	693	701	700	681	688	695	715	692	711	700	762	745	733	747	745	742	714
				690	739	739	733	724	733	738	760	735	736	729	709	694	678	693	697	695	743
				703	747	753	745	731	738	742	688	739	742	733	718	703	683	699	699	701	753
				700	747	747	738	727	733	741	753	736	736	716	704	691	755	688	690	695	741
				745	720	718	712	697	707	715	727	710	745	729	720	696	684	703	703	710	751
				717	691	691	687	753	679	688	706	682	690	677	750	726	712	726	723	727	694
				693	682	687	682	754	681	687	700	696	703	750	742	715	700	717	711	711	732
				733	739	729	736	699	706	719	699	722	746	755	689	731	714	678	682	690	709

				>;

			PS_Config_Lmt_FW_CC_P = <
				161	142	142	143	65535	65535	65535	65535	65535	65535	65535	65535	65535	65535	146	146	146	165
				149	144	144	144	144	142	142	143	146	149	146	146	144	147	147	149	149	153
				147	143	144	144	144	144	144	146	149	151	147	147	147	147	146	146	146	150
				147	144	144	144	144	146	146	146	149	149	146	146	146	146	144	143	143	146
				149	144	144	144	146	146	147	147	150	151	149	147	147	147	144	144	144	147
				147	144	143	143	144	146	146	146	149	151	147	147	147	146	144	144	144	147
				147	144	144	144	146	146	146	147	150	153	149	149	149	147	146	146	146	149
				149	146	146	146	147	147	147	149	151	151	149	149	147	147	146	144	144	149
				144	142	142	142	143	143	143	144	147	147	144	144	143	143	142	142	140	143
				144	142	142	142	143	143	143	144	147	149	146	146	144	144	143	142	142	144
				143	142	142	142	143	143	143	144	147	150	146	146	144	144	143	143	143	146
				144	142	142	142	143	143	143	144	147	149	146	144	144	143	143	142	142	144
				144	142	142	142	143	144	144	144	147	150	146	146	146	144	143	143	143	146
				144	142	142	142	143	143	144	144	147	151	147	147	146	146	144	144	144	147
				144	142	142	142	143	144	144	144	149	150	146	146	146	144	143	143	143	146
				146	143	143	143	144	146	146	146	150	150	147	146	146	146	144	144	143	146
				146	143	143	143	144	144	146	146	149	151	147	147	147	146	144	144	144	147
				144	142	143	143	144	144	144	144	149	151	149	147	147	147	146	146	144	149
				146	143	143	143	144	144	144	146	149	151	147	147	147	146	144	144	144	147
				146	143	144	143	144	146	146	146	149	151	149	147	147	147	146	146	144	149
				147	144	144	144	146	146	146	147	150	151	147	147	147	147	146	146	144	149
				147	143	144	144	144	146	146	146	149	151	149	149	147	147	146	146	146	149
				147	143	143	144	144	146	146	146	149	151	149	147	147	147	146	146	146	149
				147	144	144	144	146	146	146	147	150	151	149	149	147	147	146	146	146	150
				147	144	144	144	146	146	146	146	149	151	147	147	147	147	146	146	146	149
				147	143	143	143	144	144	146	146	149	151	149	149	147	147	146	146	146	150
				147	144	144	144	146	146	146	146	149	151	149	149	149	147	147	146	146	150
				149	144	144	144	146	146	146	147	149	151	149	149	147	147	146	146	146	150
				149	144	146	144	146	146	147	147	150	151	149	149	149	147	147	147	147	150
				147	144	144	144	144	144	146	146	149	153	150	149	149	149	147	147	147	151
				149	144	144	144	146	146	146	146	150	154	150	150	149	149	149	149	149	151
				146	155	154	150	149	149	150	151	157	160	154	153	151	153	154	158	158	147
				>;

			PS_Config_Lmt_FW_CC_N = <
				80	80	80	80	(-65535)	(-65535)	(-65535)	(-65535)	(-65535)	(-65535)	(-65535)	(-65535)	(-65535)	(-65535)	80	80	80	80
                80	80	80	80	80	80	80	80	80	80	80	80	80	80	80	80	80	80
                80	80	80	80	80	80	80	80	80	80	80	80	80	80	80	80	80	80
                80	80	80	80	80	80	80	80	80	80	80	80	80	80	80	80	80	80
                80	80	80	80	80	80	80	80	80	80	80	80	80	80	80	80	80	80
                80	80	80	80	80	80	80	80	80	80	80	80	80	80	80	80	80	80
                80	80	80	80	80	80	80	80	80	80	80	80	80	80	80	80	80	80
                80	80	80	80	80	80	80	80	80	80	80	80	80	80	80	80	80	80
                80	80	80	80	80	80	80	80	80	80	80	80	80	80	80	80	80	80
                80	80	80	80	80	80	80	80	80	80	80	80	80	80	80	80	80	80
                80	80	80	80	80	80	80	80	80	80	80	80	80	80	80	80	80	80
                80	80	80	80	80	80	80	80	80	80	80	80	80	80	80	80	80	80
                80	80	80	80	80	80	80	80	80	80	80	80	80	80	80	80	80	80
                80	80	80	80	80	80	80	80	80	80	80	80	80	80	80	80	80	80
                80	80	80	80	80	80	80	80	80	80	80	80	80	80	80	80	80	80
                80	80	80	80	80	80	80	80	80	80	80	80	80	80	80	80	80	80
                80	80	80	80	80	80	80	80	80	80	80	80	80	80	80	80	80	80
                80	80	80	80	80	80	80	80	80	80	80	80	80	80	80	80	80	80
                80	80	80	80	80	80	80	80	80	80	80	80	80	80	80	80	80	80
                80	80	80	80	80	80	80	80	80	80	80	80	80	80	80	80	80	80
                80	80	80	80	80	80	80	80	80	80	80	80	80	80	80	80	80	80
                80	80	80	80	80	80	80	80	80	80	80	80	80	80	80	80	80	80
                80	80	80	80	80	80	80	80	80	80	80	80	80	80	80	80	80	80
                80	80	80	80	80	80	80	80	80	80	80	80	80	80	80	80	80	80
                80	80	80	80	80	80	80	80	80	80	80	80	80	80	80	80	80	80
                80	80	80	80	80	80	80	80	80	80	80	80	80	80	80	80	80	80
                80	80	80	80	80	80	80	80	80	80	80	80	80	80	80	80	80	80
                80	80	80	80	80	80	80	80	80	80	80	80	80	80	80	80	80	80
                80	80	80	80	80	80	80	80	80	80	80	80	80	80	80	80	80	80
                80	80	80	80	80	80	80	80	80	80	80	80	80	80	80	80	80	80
                80	80	80	80	80	80	80	80	80	80	80	80	80	80	80	80	80	80
                80	80	80	80	80	80	80	80	80	80	80	80	80	80	80	80	80	80
				>;

			PS_Config_Lmt_FW_Diff_P = <
					50	50	50	50	65535	65535	65535	65535	65535	65535	65535	65535	65535	65535	50	50	50	50
					50	50	50	50	50	50	50	50	50	50	50	50	50	50	50	50	50	50
					50	50	50	50	50	50	50	50	50	50	50	50	50	50	50	50	50	50
					50	50	50	50	50	50	50	50	50	50	50	50	50	50	50	50	50	50
					50	50	50	50	50	50	50	50	50	50	50	50	50	50	50	50	50	50
					50	50	50	50	50	50	50	50	50	50	50	50	50	50	50	50	50	50
					50	50	50	50	50	50	50	50	50	50	50	50	50	50	50	50	50	50
					50	50	50	50	50	50	50	50	50	50	50	50	50	50	50	50	50	50
					50	50	50	50	50	50	50	50	50	50	50	50	50	50	50	50	50	50
					50	50	50	50	50	50	50	50	50	50	50	50	50	50	50	50	50	50
					50	50	50	50	50	50	50	50	50	50	50	50	50	50	50	50	50	50
					50	50	50	50	50	50	50	50	50	50	50	50	50	50	50	50	50	50
					50	50	50	50	50	50	50	50	50	50	50	50	50	50	50	50	50	50
					50	50	50	50	50	50	50	50	50	50	50	50	50	50	50	50	50	50
					50	50	50	50	50	50	50	50	50	50	50	50	50	50	50	50	50	50
					50	50	50	50	50	50	50	50	50	50	50	50	50	50	50	50	50	50
					50	50	50	50	50	50	50	50	50	50	50	50	50	50	50	50	50	50
					50	50	50	50	50	50	50	50	50	50	50	50	50	50	50	50	50	50
					50	50	50	50	50	50	50	50	50	50	50	50	50	50	50	50	50	50
					50	50	50	50	50	50	50	50	50	50	50	50	50	50	50	50	50	50
					50	50	50	50	50	50	50	50	50	50	50	50	50	50	50	50	50	50
					50	50	50	50	50	50	50	50	50	50	50	50	50	50	50	50	50	50
					50	50	50	50	50	50	50	50	50	50	50	50	50	50	50	50	50	50
					50	50	50	50	50	50	50	50	50	50	50	50	50	50	50	50	50	50
					50	50	50	50	50	50	50	50	50	50	50	50	50	50	50	50	50	50
					50	50	50	50	50	50	50	50	50	50	50	50	50	50	50	50	50	50
					50	50	50	50	50	50	50	50	50	50	50	50	50	50	50	50	50	50
					50	50	50	50	50	50	50	50	50	50	50	50	50	50	50	50	50	50
					50	50	50	50	50	50	50	50	50	50	50	50	50	50	50	50	50	50
					50	50	50	50	50	50	50	50	50	50	50	50	50	50	50	50	50	50
					50	50	50	50	50	50	50	50	50	50	50	50	50	50	50	50	50	50
					50	50	50	50	50	50	50	50	50	50	50	50	50	50	50	50	50	50
				35 35 35>;

			PS_Config_Lmt_FW_Diff_N = <
				(-50) (-50) (-50) (-50)  (-65535) (-65535) (-65535) (-65535) (-65535) (-65535) (-65535) (-65535) (-65535) (-65535) (-50) (-50) (-50) (-50)
				(-50) (-50) (-50) (-50) (-50) (-50) (-50) (-50) (-50) (-50) (-50) (-50) (-50) (-50) (-50) (-50) (-50) (-50)
				(-50) (-50) (-50) (-50) (-50) (-50) (-50) (-50) (-50) (-50) (-50) (-50) (-50) (-50) (-50) (-50) (-50) (-50)
				(-50) (-50) (-50) (-50) (-50) (-50) (-50) (-50) (-50) (-50) (-50) (-50) (-50) (-50) (-50) (-50) (-50) (-50)
				(-50) (-50) (-50) (-50) (-50) (-50) (-50) (-50) (-50) (-50) (-50) (-50) (-50) (-50) (-50) (-50) (-50) (-50)
				(-50) (-50) (-50) (-50) (-50) (-50) (-50) (-50) (-50) (-50) (-50) (-50) (-50) (-50) (-50) (-50) (-50) (-50)
				(-50) (-50) (-50) (-50) (-50) (-50) (-50) (-50) (-50) (-50) (-50) (-50) (-50) (-50) (-50) (-50) (-50) (-50)
				(-50) (-50) (-50) (-50) (-50) (-50) (-50) (-50) (-50) (-50) (-50) (-50) (-50) (-50) (-50) (-50) (-50) (-50)
				(-50) (-50) (-50) (-50) (-50) (-50) (-50) (-50) (-50) (-50) (-50) (-50) (-50) (-50) (-50) (-50) (-50) (-50)
				(-50) (-50) (-50) (-50) (-50) (-50) (-50) (-50) (-50) (-50) (-50) (-50) (-50) (-50) (-50) (-50) (-50) (-50)
				(-50) (-50) (-50) (-50) (-50) (-50) (-50) (-50) (-50) (-50) (-50) (-50) (-50) (-50) (-50) (-50) (-50) (-50)
				(-50) (-50) (-50) (-50) (-50) (-50) (-50) (-50) (-50) (-50) (-50) (-50) (-50) (-50) (-50) (-50) (-50) (-50)
				(-50) (-50) (-50) (-50) (-50) (-50) (-50) (-50) (-50) (-50) (-50) (-50) (-50) (-50) (-50) (-50) (-50) (-50)
				(-50) (-50) (-50) (-50) (-50) (-50) (-50) (-50) (-50) (-50) (-50) (-50) (-50) (-50) (-50) (-50) (-50) (-50)
				(-50) (-50) (-50) (-50) (-50) (-50) (-50) (-50) (-50) (-50) (-50) (-50) (-50) (-50) (-50) (-50) (-50) (-50)
				(-50) (-50) (-50) (-50) (-50) (-50) (-50) (-50) (-50) (-50) (-50) (-50) (-50) (-50) (-50) (-50) (-50) (-50)
				(-50) (-50) (-50) (-50) (-50) (-50) (-50) (-50) (-50) (-50) (-50) (-50) (-50) (-50) (-50) (-50) (-50) (-50)
				(-50) (-50) (-50) (-50) (-50) (-50) (-50) (-50) (-50) (-50) (-50) (-50) (-50) (-50) (-50) (-50) (-50) (-50)
				(-50) (-50) (-50) (-50) (-50) (-50) (-50) (-50) (-50) (-50) (-50) (-50) (-50) (-50) (-50) (-50) (-50) (-50)
				(-50) (-50) (-50) (-50) (-50) (-50) (-50) (-50) (-50) (-50) (-50) (-50) (-50) (-50) (-50) (-50) (-50) (-50)
				(-50) (-50) (-50) (-50) (-50) (-50) (-50) (-50) (-50) (-50) (-50) (-50) (-50) (-50) (-50) (-50) (-50) (-50)
				(-50) (-50) (-50) (-50) (-50) (-50) (-50) (-50) (-50) (-50) (-50) (-50) (-50) (-50) (-50) (-50) (-50) (-50)
				(-50) (-50) (-50) (-50) (-50) (-50) (-50) (-50) (-50) (-50) (-50) (-50) (-50) (-50) (-50) (-50) (-50) (-50)
				(-50) (-50) (-50) (-50) (-50) (-50) (-50) (-50) (-50) (-50) (-50) (-50) (-50) (-50) (-50) (-50) (-50) (-50)
				(-50) (-50) (-50) (-50) (-50) (-50) (-50) (-50) (-50) (-50) (-50) (-50) (-50) (-50) (-50) (-50) (-50) (-50)
				(-50) (-50) (-50) (-50) (-50) (-50) (-50) (-50) (-50) (-50) (-50) (-50) (-50) (-50) (-50) (-50) (-50) (-50)
				(-50) (-50) (-50) (-50) (-50) (-50) (-50) (-50) (-50) (-50) (-50) (-50) (-50) (-50) (-50) (-50) (-50) (-50)
				(-50) (-50) (-50) (-50) (-50) (-50) (-50) (-50) (-50) (-50) (-50) (-50) (-50) (-50) (-50) (-50) (-50) (-50)
				(-50) (-50) (-50) (-50) (-50) (-50) (-50) (-50) (-50) (-50) (-50) (-50) (-50) (-50) (-50) (-50) (-50) (-50)
				(-50) (-50) (-50) (-50) (-50) (-50) (-50) (-50) (-50) (-50) (-50) (-50) (-50) (-50) (-50) (-50) (-50) (-50)
				(-50) (-50) (-50) (-50) (-50) (-50) (-50) (-50) (-50) (-50) (-50) (-50) (-50) (-50) (-50) (-50) (-50) (-50)
				(-50) (-50) (-50) (-50) (-50) (-50) (-50) (-50) (-50) (-50) (-50) (-50) (-50) (-50) (-50) (-50) (-50) (-50)
				(-35) (-35) (-35)>;

			PS_Config_Diff_Test_Frame = <50>;
		};
	};
};
