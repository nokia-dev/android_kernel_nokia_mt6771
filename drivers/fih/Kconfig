## drivers/fih/Kconfig
```kconfig
#
# OEM driver
#

#Kernel Module sign key from FIH
config MODULE_SIG_FIH
	bool "Use static module sign key"
	depends on MODULE_SIG
	help
	  Use the static module sign key
	  in kernel/cert/fih/

choice
	prompt "Define fih sig key path"
	depends on MODULE_SIG_FIH
	default MODULE_SIG_KEY_IN_NORMAL
	help
	  fih sig key path

config MODULE_SIG_KEY_IN_NORMAL
	bool "Key for normal"

endchoice

config MODULE_SIG_FIH_KEY_PATH
	string
	depends on MODULE_SIG_FIH
	default "../../../../../../kernel/certs/fih" if MODULE_SIG_KEY_IN_NORMAL
```

## drivers/input/fingerprint/elan/Kconfig
```kconfig
#
# Configuration for ELAN
#

config ELAN_EFSA680RC
	bool "ELAN EFSA680RC Driver"
	default n
	---help---
	  This is a ELAN EFSA680RC chipset Driver.
```

## drivers/input/fingerprint/goodix/Kconfig
```kconfig
#
# Configuration for GOODIX
#

config GOODIX_FINGERPRINT
	bool "GOODIX Driver"
	default n
	---help---
	  This is a GOODIX chipset Driver.
```

## drivers/input/fingerprint/zet/Kconfig
```kconfig
#
# Configuration for ZEITECSEMI
#

config ZET_ZFS1670A
	bool "ZEITECSEMI ZFS1670A Driver"
	default n
	---help---
	  This is a ZEITECSEMI ZFS1670A chipset Driver.
```

## drivers/input/touchscreen/mediatek/ILI9881H/Kconfig
```kconfig
#
# ILITEK I2C Touchscreen driver
#

config TOUCHSCREEN_ILI9881H
	tristate "ILITEK I2C touchscreen driver for linux platform"
	default y
	help
	  This is the main file for touchpanel driver for ILITEK I2C
	  touchscreens.

	  Say Y here if you have a ILITEK I2C touchscreen connected
	  to your system.

	  If unsure, say N.
```
